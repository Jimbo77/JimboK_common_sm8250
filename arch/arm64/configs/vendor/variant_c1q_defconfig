## arch/arm64/configs/vendor/variant_c1q_defconfig
```kconfig
# CONFIG_SEC_X1Q_PROJECT is not set
# CONFIG_SEC_Y2Q_PROJECT is not set
# CONFIG_SEC_Z3Q_PROJECT is not set
CONFIG_SEC_C1Q_PROJECT=y

#
# Samsung Canvas
#
# CONFIG_MACH_C1Q_USA_SINGLE is not set
# CONFIG_MACH_C1Q_CAN_SINGLE is not set
CONFIG_MACH_C1Q_KOR_SINGLE=y
# CONFIG_MACH_C1Q_CHN_OPEN is not set
# CONFIG_MACH_C1Q_CHN_HK is not set
# CONFIG_MACH_C2Q_USA_SINGLE is not set
# CONFIG_MACH_C2Q_KOR_SINGLE is not set
# CONFIG_MACH_C2Q_CAN_SINGLE is not set
# CONFIG_MACH_C2Q_JPN_SINGLE is not set
# CONFIG_MACH_C2Q_CHN_OPEN is not set
# CONFIG_MACH_C2Q_CHN_HK is not set

CONFIG_BT_BCM4361=y
CONFIG_BT_BLUESLEEP=y

CONFIG_WLAN_BCM4375_ADVANCED_FEATURES=y

CONFIG_TOUCHSCREEN_SEC_TS_Y79A_C=y

CONFIG_INPUT_WACOM=y
CONFIG_EPEN_WACOM_W9020=y
CONFIG_SAMSUNG_OIS_TAMODE_CONTROL=y

CONFIG_SAMSUNG_REAR_TELE_BINNING=y
CONFIG_CAMERA_SSM_I2C_ENV=y

CONFIG_LEDS_S2MPB02=y

CONFIG_PANEL_S6E3HAB_AMB687TZ01_WQHD=y
CONFIG_PANEL_S6E3FA9_AMB667UM01_FHD=y
CONFIG_PANEL_S6E3FAB_AMB643VW01_FHD=y

CONFIG_SAMSUNG_UWB=y
CONFIG_UWB_SR100=y

CONFIG_PD_CHARGER_HV_DISABLE=y
CONFIG_WIRELESS_CHARGER_MFC_S2MIW04=y
CONFIG_SENSORS_SX9360=y

CONFIG_LPS22HH_FACTORY=y
CONFIG_TMD490X_FACTORY=y
CONFIG_SUPPORT_TMD4907_FACTORY=y
CONFIG_SUPPORT_AMS_LIGHT_LCD_VERSION_DUALIZAION=y
CONFIG_SUPPORT_AMS_LIGHT_CALIBRATION=y
CONFIG_SUPPORT_AMS_PROX_CALIBRATION=y
CONFIG_SUPPORT_PROX_AUTO_CAL=y
CONFIG_SUPPORT_BRIGHTNESS_NOTIFY_FOR_LIGHT_SENSOR=y
CONFIG_SUPPORT_DDI_COPR_FOR_LIGHT_SENSOR=y
CONFIG_MOTOR_DRV_CS40L2X=y
CONFIG_MOTOR_DRV_CS40L2X_PMIC_RESET=y
CONFIG_CS40L2X_SAMSUNG_FEATURE=y
CONFIG_SENSORS_QBT2000=y


CONFIG_SUPPORT_MCC_THRESHOLD_CHANGE=y
CONFIG_SUPPORT_PROX_INIT_CAL=y
CONFIG_SUPPORT_HIDDEN_HOLE=y

CONFIG_SS_VIBRATOR=y
CONFIG_BOOST_POWER_SHARE=y
CONFIG_MOTOR_DRV_MAX77705=y
CONFIG_MST_LDO=y
CONFIG_MST_V2=y
CONFIG_MFC_CHARGER=y
```

## arch/arm64/configs/vendor/variant_c2q_defconfig
```kconfig
# CONFIG_SEC_X1Q_PROJECT is not set
# CONFIG_SEC_Y2Q_PROJECT is not set
# CONFIG_SEC_Z3Q_PROJECT is not set
# CONFIG_SEC_C1Q_PROJECT is not set
CONFIG_SEC_C2Q_PROJECT=y

# Samsung Canvas
#
# CONFIG_MACH_C1Q_USA_SINGLE is not set
# CONFIG_MACH_C1Q_CAN_SINGLE is not set
# CONFIG_MACH_C1Q_KOR_SINGLE is not set
# CONFIG_MACH_C1Q_CHN_OPEN is not set
# CONFIG_MACH_C1Q_CHN_HK is not set
# CONFIG_MACH_C2Q_USA_SINGLE is not set
CONFIG_MACH_C2Q_KOR_SINGLE=y
# CONFIG_MACH_C2Q_CAN_SINGLE is not set
# CONFIG_MACH_C2Q_JPN_SINGLE is not set
# CONFIG_MACH_C2Q_CHN_OPEN is not set
# CONFIG_MACH_C2Q_CHN_HK is not set

CONFIG_CONNECTOR=y
CONFIG_PROC_EVENTS=y

CONFIG_WLAN_BCM4375_ADVANCED_FEATURES=y

CONFIG_TOUCHSCREEN_SEC_TS_Y79A_C=y

CONFIG_INPUT_WACOM=y
CONFIG_EPEN_WACOM_W9020=y

CONFIG_SAMSUNG_OIS_TAMODE_CONTROL=y
CONFIG_SAMSUNG_REAR_TELE_TETRA=y
CONFIG_SAMSUNG_ACTUATOR_PREVENT_SHAKING=y
CONFIG_SAMSUNG_SUPPORT_REMOSAIC_MFNR_FEATURE=y

CONFIG_PANEL_S6E3HAB_AMB687TZ01_WQHD=y
CONFIG_PANEL_S6E3HAC_AMB687VX01_WQHD=y

CONFIG_SAMSUNG_UWB=y
CONFIG_UWB_SR100=y
CONFIG_SEC_UWB_LOGGER=y

CONFIG_WIRELESS_CHARGER_MFC_S2MIW04=y
CONFIG_SENSORS_SX9360=y
CONFIG_SUPPORT_MCC_THRESHOLD_CHANGE=y
CONFIG_SENSORS_VL53L5=y
CONFIG_SENSORS_VL53L5_SUPPORT_UAPI=y

CONFIG_SUPPORT_PROX_INIT_CAL=y
CONFIG_SUPPORT_HIDDEN_HOLE=y

CONFIG_MST_LDO=y
CONFIG_MST_V2=y
CONFIG_MFC_CHARGER=y
```

## arch/arm64/configs/vendor/variant_r8q_defconfig
```kconfig
CONFIG_SEC_R8Q_PROJECT=y
CONFIG_MACH_R8Q_EUR_OPEN=y
CONFIG_PROCESS_RECLAIM_IGNORE_ALL_TYPE=y
CONFIG_COMPAT_NETLINK_MESSAGES=y
CONFIG_MSM_BT_POWER=y
CONFIG_BTFM_SLIM=y
CONFIG_BT_SLIM_QCA6390=y
CONFIG_WIRELESS_EXT=y
CONFIG_WEXT_CORE=y
CONFIG_WEXT_PROC=y
CONFIG_WEXT_SPY=y
CONFIG_WEXT_PRIV=y

#Disables some options that are needed for other models:

# CONFIG_CFG80211_REG_NOT_UPDATED is not set
# CONFIG_SAMSUNG_NFC is not set
# CONFIG_NFC_PN547 is not set
# CONFIG_NFC_PN547_ESE_SUPPORT is not set
# CONFIG_NFC_FEATURE_SN100U is not set
CONFIG_ESE_SECURE_GPIO=-1

CONFIG_SEC_NFC_V2=y
CONFIG_ESE_P3_V2_LSI=y

CONFIG_OF_SLIMBUS=y
CONFIG_CNSS_UTILS=y
CONFIG_CNSS_QMI_SVC=y

CONFIG_TOUCHSCREEN_ZINITIX_ZT7650=y

CONFIG_SAMSUNG_SBI=y
CONFIG_CAMERA_SSM_I2C_ENV=y
CONFIG_SAMSUNG_FRONT_FIXED_FOCUS=y

CONFIG_PANEL_EA8076A_AMS646UJ10_FHD=y
CONFIG_PANEL_EA8079B_AMS646YB01_FHD=y

CONFIG_LEDS_RT8547=y
CONFIG_ION_RBIN_HEAP_EXCEPTION=y

CONFIG_SLIMBUS_MSM_NGD=y
CONFIG_TX_5V_DISABLE=y

CONFIG_SENSORS_FW_VENDOR=y
CONFIG_SENSORS_A96T3X6=y
CONFIG_SENSORS_A96T3X6_CRC_CHECK=y
CONFIG_SENSORS_A96T3X6_BLOCK_SAR_ONLY=y
CONFIG_SENSORS_A96T3X6_FORCE_FW_UPDATE=y

CONFIG_SUPPORT_STK33610_FACTORY=y
CONFIG_SS_VIBRATOR=y
CONFIG_MOTOR_DRV_MAX77705=y
CONFIG_SENSORS_GW9558X=y
```

## arch/arm64/configs/vendor/variant_y2q_defconfig
```kconfig
# CONFIG_SEC_X1Q_PROJECT is not set
CONFIG_SEC_Y2Q_PROJECT=y
# CONFIG_SEC_Z3Q_PROJECT is not set

# Samsung X/Y/Z
#
# CONFIG_MACH_Y2Q_KOR_SINGLE is not set
# CONFIG_MACH_Y2Q_USA_SINGLE is not set
# CONFIG_MACH_Y2Q_CAN_SINGLE is not set
CONFIG_MACH_Y2Q_CHN_OPEN=y
# CONFIG_MACH_X1Q_CHN_HKX is not set
# CONFIG_MACH_Y2Q_CHN_HKX is not set
# CONFIG_MACH_Z3Q_CHN_HKX is not set
# CONFIG_MACH_Y2Q_JPN_SINGLE is not set
# CONFIG_MACH_Y2Q_JPN_DCMOLY is not set

CONFIG_KEYBOARD_STM_FSR=y

CONFIG_TOUCHSCREEN_SEC_TS_Y79A=y

CONFIG_SAMSUNG_SBI=y
CONFIG_SAMSUNG_REAR_TOF=y
CONFIG_SAMSUNG_REAR_TELE_BINNING=y
CONFIG_CAMERA_SSM_I2C_ENV=y

CONFIG_PANEL_S6E3HA9_AMB611WE01_WQHD=y
CONFIG_PANEL_S6E3HA9_AMB644WF01_WQHD=y
CONFIG_PANEL_S6E3HAB_AMB677TY01_WQHD=y

CONFIG_SENSORS_SX9360=y
```

## arch/arm64/configs/vendor/variant_z3q_defconfig
```kconfig
# CONFIG_SEC_X1Q_PROJECT is not set
# CONFIG_SEC_Y2Q_PROJECT is not set
CONFIG_SEC_Z3Q_PROJECT=y

CONFIG_MACH_Z3Q_KOR_SINGLE=y
# CONFIG_MACH_Z3Q_USA_SINGLE is not set
# CONFIG_MACH_Z3Q_CAN_SINGLE isnot set
# CONFIG_MACH_Z3Q_CHN_OPEN isnot set
# CONFIG_MACH_Z3Q_JPN_SINGLE is not set

CONFIG_BT_BCM4361=y
CONFIG_BT_BLUESLEEP=y

CONFIG_KEYBOARD_STM_FSR=y
# CONFIG_SAMSUNG_SBI is not set

CONFIG_TOUCHSCREEN_SEC_TS_Y79A=y

CONFIG_SAMSUNG_REAR_TOF=y
# CONFIG_SAMSUNG_REAR_TELE_BINNING is not set
CONFIG_SAMSUNG_REAR_TELE_TETRA=y
CONFIG_SAMSUNG_ACTUATOR_PREVENT_SHAKING=y

CONFIG_PANEL_S6E3HAB_AMB687TZ01_WQHD=y

CONFIG_LEDS_S2MPB02=y

CONFIG_PD_CHARGER_HV_DISABLE=y
CONFIG_WIRELESS_CHARGER_MFC_S2MIW04=y

# CONFIG_SENSORS_SX9360 is not set
CONFIG_SENSORS_FW_VENDOR=y
CONFIG_SUPPORT_MCC_THRESHOLD_CHANGE=y
CONFIG_SENSORS_A96T3X6=y
CONFIG_SENSORS_A96T3X6_CRC_CHECK=y
CONFIG_SENSORS_A96T3X6_BLOCK_SAR_ONLY=y
CONFIG_SENSORS_A96T365IF=y
CONFIG_LPS22HH_FACTORY=y
CONFIG_TMD490X_FACTORY=y
CONFIG_SUPPORT_TMD4907_FACTORY=y
CONFIG_SUPPORT_AMS_LIGHT_LCD_VERSION_DUALIZAION=y
CONFIG_SUPPORT_AMS_LIGHT_CALIBRATION=y
CONFIG_SUPPORT_AMS_PROX_CALIBRATION=y
CONFIG_SUPPORT_PROX_AUTO_CAL=y
CONFIG_SUPPORT_BRIGHTNESS_NOTIFY_FOR_LIGHT_SENSOR=y
CONFIG_SUPPORT_DDI_COPR_FOR_LIGHT_SENSOR=y
CONFIG_MOTOR_DRV_CS40L2X=y
CONFIG_MOTOR_DRV_CS40L2X_PMIC_RESET=y
CONFIG_CS40L2X_SAMSUNG_FEATURE=y
CONFIG_SENSORS_QBT2000=y

CONFIG_MST_LDO=y
CONFIG_MST_V2=y
CONFIG_MFC_CHARGER=y
```
